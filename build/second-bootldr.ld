ENTRY(bootloader_main)
OUTPUT_ARCH(i386)
OUTPUT_FORMAT(binary)
SECTIONS {
	__PTR_BASE_ADDRESS__ = 0x1000;
	. = __PTR_BASE_ADDRESS__;

	.header : {
		SHORT(__PTR_BASE_ADDRESS__);
		SHORT(((__PTR_END_ADDRESS__ - __PTR_BASE_ADDRESS__ + 511) & ~511) / 512);
		SHORT(bootloader_main);
	}

	.text : {
		*(.text)
	}

	.data BLOCK(512) : ALIGN(512) {
		*(.data)
	}

	.rodata BLOCK(512) : ALIGN(512) {
		*(.rodata)
	}

	.bss BLOCK(512) : ALIGN(512) {
		*(.bss)
	}

	.padding BLOCK(512) : ALIGN(512) {
		QUAD(0xFEEBFEEBFEEBFEEB); QUAD(0xFEEBFEEBFEEBFEEB); QUAD(0xFEEBFEEBFEEBFEEB); QUAD(0xFEEBFEEBFEEBFEEB);
		QUAD(0xFEEBFEEBFEEBFEEB); QUAD(0xFEEBFEEBFEEBFEEB); QUAD(0xFEEBFEEBFEEBFEEB); QUAD(0xFEEBFEEBFEEBFEEB);
		QUAD(0xFEEBFEEBFEEBFEEB); QUAD(0xFEEBFEEBFEEBFEEB); QUAD(0xFEEBFEEBFEEBFEEB); QUAD(0xFEEBFEEBFEEBFEEB);
		QUAD(0xFEEBFEEBFEEBFEEB); QUAD(0xFEEBFEEBFEEBFEEB); QUAD(0xFEEBFEEBFEEBFEEB); QUAD(0xFEEBFEEBFEEBFEEB);
		QUAD(0xFEEBFEEBFEEBFEEB); QUAD(0xFEEBFEEBFEEBFEEB); QUAD(0xFEEBFEEBFEEBFEEB); QUAD(0xFEEBFEEBFEEBFEEB);
		QUAD(0xFEEBFEEBFEEBFEEB); QUAD(0xFEEBFEEBFEEBFEEB); QUAD(0xFEEBFEEBFEEBFEEB); QUAD(0xFEEBFEEBFEEBFEEB);
		QUAD(0xFEEBFEEBFEEBFEEB); QUAD(0xFEEBFEEBFEEBFEEB); QUAD(0xFEEBFEEBFEEBFEEB); QUAD(0xFEEBFEEBFEEBFEEB);
		QUAD(0xFEEBFEEBFEEBFEEB); QUAD(0xFEEBFEEBFEEBFEEB); QUAD(0xFEEBFEEBFEEBFEEB); QUAD(0xFEEBFEEBFEEBFEEB);
		QUAD(0xFEEBFEEBFEEBFEEB); QUAD(0xFEEBFEEBFEEBFEEB); QUAD(0xFEEBFEEBFEEBFEEB); QUAD(0xFEEBFEEBFEEBFEEB);
		QUAD(0xFEEBFEEBFEEBFEEB); QUAD(0xFEEBFEEBFEEBFEEB); QUAD(0xFEEBFEEBFEEBFEEB); QUAD(0xFEEBFEEBFEEBFEEB);
		QUAD(0xFEEBFEEBFEEBFEEB); QUAD(0xFEEBFEEBFEEBFEEB); QUAD(0xFEEBFEEBFEEBFEEB); QUAD(0xFEEBFEEBFEEBFEEB);
		QUAD(0xFEEBFEEBFEEBFEEB); QUAD(0xFEEBFEEBFEEBFEEB); QUAD(0xFEEBFEEBFEEBFEEB); QUAD(0xFEEBFEEBFEEBFEEB);
		QUAD(0xFEEBFEEBFEEBFEEB); QUAD(0xFEEBFEEBFEEBFEEB); QUAD(0xFEEBFEEBFEEBFEEB); QUAD(0xFEEBFEEBFEEBFEEB);
		QUAD(0xFEEBFEEBFEEBFEEB); QUAD(0xFEEBFEEBFEEBFEEB); QUAD(0xFEEBFEEBFEEBFEEB); QUAD(0xFEEBFEEBFEEBFEEB);
		QUAD(0xFEEBFEEBFEEBFEEB); QUAD(0xFEEBFEEBFEEBFEEB); QUAD(0xFEEBFEEBFEEBFEEB); QUAD(0xFEEBFEEBFEEBFEEB);
		QUAD(0xFEEBFEEBFEEBFEEB); QUAD(0xFEEBFEEBFEEBFEEB); QUAD(0xFEEBFEEBFEEBFEEB); QUAD(0xFEEBFEEBFEEBFEEB);
	}

	__PTR_END_ADDRESS__ = .;
}